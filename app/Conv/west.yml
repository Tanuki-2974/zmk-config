## app/Conv/west.yml
```yaml
manifest:
  remotes:
    - name: zmkfirmware
      url-base: https://github.com/zmkfirmware
    # Additional modules containing boards/shields/custom code can be listed here as well
    # See https://docs.zephyrproject.org/3.2.0/develop/west/manifest.html#projects
    - name: Tanuki-2974
      url-base: https://github.com/Tanuki-2974
  projects:
    - name: zmk
      remote: zmkfirmware
      revision: main
      import: app/west.yml
    - name: zmk-pmw3610-driver
      remote: Tanuki-2974
      revision: main
    - name: zmk-rgbled-widget
      remote: Tanuki-2974
      revision: main
  self:
    path: app/Conv
```

## boards/shields/Conv/Kconfig.defconfig
```kconfig
if SHIELD_Conv_L

config ZMK_KEYBOARD_NAME
    default "Conv"

config ZMK_SPLIT_ROLE_CENTRAL
    default y

endif

if SHIELD_Conv_L || SHIELD_Conv_R

config ZMK_SPLIT
    default y

config ZMK_SLEEP
    default y

config ZMK_POINTING
    default y

config ZMK_POINTING_SMOOTH_SCROLLING
    default n

config SPI
    default y

config INPUT
    default y

config INPUT_PMW3610
    default y

endif
```

## boards/shields/Conv_common/Kconfig.defconfig
```kconfig
if SHIELD_Conv_L

config ZMK_KEYBOARD_NAME
    default "Conv"

config ZMK_SPLIT_ROLE_CENTRAL
    default y

endif

if SHIELD_Conv_L || SHIELD_Conv_R

config ZMK_SPLIT
    default y

config ZMK_SLEEP
    default y

config ZMK_POINTING
    default y

config ZMK_POINTING_SMOOTH_SCROLLING
    default n

config SPI
    default y

config PMW3610
    default y

config PMW3610_SWAP_XY
    default y

config PMW3610_REPORT_INTERVAL_MIN
    default 8

endif
```

## boards/shields/NuLu/Kconfig.defconfig
```kconfig
if SHIELD_NULU_L || SHIELD_NULU_R
    config ZMK_SPLIT
        default y

    config ZMK_BLE
        default y

    config ZMK_SLEEP
        default y
endif

if SHIELD_NULU_L
    config ZMK_KEYBOARD_NAME
        default "NuLu_L"

    config ZMK_SPLIT_ROLE_CENTRAL
        default y
endif

if SHIELD_NULU_R
    config ZMK_KEYBOARD_NAME
        default "NuLu_R"
endif
```

## boards/shields/NuLu/Kconfig.shield
```kconfig
config SHIELD_NULU_L
    def_bool $(shields_list_contains,NuLu_L)

config SHIELD_NULU_R
    def_bool $(shields_list_contains,NuLu_R)
```

## config/boards/arm/seeed_xiao_nrf52840_plus/board.yml
```yaml
board:
  name: xiao_ble_plus
  full_name: XIAO BLE PLUS (Sense)
  vendor: seeed
  socs:
  - name: nrf52840
    variants:
    - name: 'sense'
```

## config/boards/shields/Conv/Kconfig.defconfig
```kconfig
if SHIELD_Conv_R

config ZMK_KEYBOARD_NAME
    default "Conv_R"

config ZMK_SPLIT
    default y

endif

if SHIELD_Conv_L

config ZMK_KEYBOARD_NAME
    default "Conv_L"

config ZMK_SPLIT
    default y

config ZMK_SPLIT_ROLE_CENTRAL
    default y

endif
```

## config/boards/shields/Conv/Kconfig.shield
```kconfig
config SHIELD_Conv_L
    def_bool $(shields_list_contains,Conv_L)

config SHIELD_Conv_R
    def_bool $(shields_list_contains,Conv_R)
```

## config/boards/shields/NuLu/Kconfig.defconfig
```kconfig
if SHIELD_NuLu_L || SHIELD_NuLu_R
    config ZMK_SPLIT
        default y

    config ZMK_SLEEP
        default y
endif

if SHIELD_NuLu_L
    config ZMK_KEYBOARD_NAME
        default "NuLu_L"

    config ZMK_SPLIT_ROLE_CENTRAL
        default y
endif

if SHIELD_NuLu_R
    config ZMK_KEYBOARD_NAME
        default "NuLu_R"
endif
```

## config/west.yml
```yaml
manifest:
  remotes:
    - name: zmkfirmware
      url-base: https://github.com/zmkfirmware
    # Additional modules containing boards/shields/custom code can be listed here as well
    # See https://docs.zephyrproject.org/3.2.0/develop/west/manifest.html#projects
    - name: badjeff
      url-base: https://github.com/badjeff
    - name: Tanuki-2974
      url-base: https://github.com/Tanuki-2974
  projects:
    - name: zmk
      remote: zmkfirmware
      revision: main
      import: app/west.yml
    - name: zmk-pmw3610-driver
      remote: Tanuki-2974
      revision: main
  self:
    path: config
```
