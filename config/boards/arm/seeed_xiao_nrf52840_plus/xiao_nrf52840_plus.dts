/*
 * Copyright (c) 2022-2023 Marcin Niestroj
 *
 * SPDX-License-Identifier: Apache-2.0
 */

/dts-v1/;
#include "xiao_ble_plus_common.dtsi"

/ {
	model = "Seeed XIAO BLE PLUS";
	compatible = "seeed,xiao-ble-plus";
};